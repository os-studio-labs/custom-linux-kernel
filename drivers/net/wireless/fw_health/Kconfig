## drivers/net/wireless/fw_health/Kconfig
```kconfig
# SPDX-License-Identifier: GPL-2.0
#
# Firmware health monitoring framework for wireless drivers

config FW_HEALTH
	tristate "Firmware health monitoring and recovery framework"
	depends on RUST
	help
	  Lockless firmware health monitor for wireless drivers.
	  Provides automatic crash detection, recovery triggering,
	  and diagnostic logging.  All wireless drivers can
	  optionally link against this module.

	  When in doubt, say M.
```

## drivers/rust_core/Kconfig
```kconfig
# SPDX-License-Identifier: GPL-2.0
#
# Rust Driver Core — safe wrappers for any driver subsystem

config RUST_CORE
	tristate "Rust Driver Core — safe DMA/PCI/devres wrappers"
	depends on RUST
	help
	  Universal Rust safety layer for all driver subsystems.
	  Provides RAII-style DMA mappings, bounds-checked PCI config
	  access, automatic devres cleanup, and safe MMIO operations.
	  Any Linux driver (GPU, storage, net, USB, audio, etc.) can
	  link against this module to eliminate entire classes of
	  memory-safety and resource-leak bugs.

	  When in doubt, say M.

config RUST_CORE_DMA
	bool "Safe DMA mapping wrappers"
	depends on RUST_CORE
	default y
	help
	  RAII DMA mappings that record device, direction, and length
	  so that unmapping is always correct.  Prevents the most
	  common class of DMA bugs.

config RUST_CORE_PCI
	bool "Safe PCI config space access"
	depends on RUST_CORE && PCI
	default y
	help
	  Bounds-checked PCI configuration space access.
	  Eliminates out-of-bounds config space reads/writes.

config RUST_CORE_DEVRES
	bool "Safe devres (device-managed resource) tracking"
	depends on RUST_CORE
	default y
	help
	  Automatic cleanup for driver resources via the kernel's
	  devres framework, with Rust-level type safety.
```

## kernel/Kconfig.sentraos_rustcore
```kconfig
# SPDX-License-Identifier: GPL-2.0

config SENTRAOS_RUSTCORE
	bool "SentraOS Rust Core — rewrite kernel core in Rust"
	depends on RUST
	help
	  Replaces legacy C kernel subsystems with modern Rust implementations:
	    - panic handler (detailed box-art explanations)
	    - scheduler (EEVDF, lockless per-CPU runqueues)
	    - process manager (fork/exit/signal with sandbox tracking)
	    - boot logger (structured startup/shutdown output)
	    - calls dispatch (modern syscall replacement)
	    - VFS (capability-based FD passing)
	    - memory manager (per-sandbox budgets, lockless allocator)

	  These modules compile alongside the existing C code.  The C code
	  is bypassed at runtime when the Rust version is loaded.

	  If unsure, say N.

config SENTRAOS_OOM_RUST
	bool "SentraOS OOM Killer — ML-like context-aware scoring"
	depends on SENTRAOS_RUSTCORE
	help
	  Replaces the legacy OOM killer heuristic (mm/oom_kill.c) with a
	  15-factor weighted scoring model that considers sandbox priority,
	  cgroup context, interactivity, memory growth rate, CPU time,
	  DMA allocations, and more.  Provides OOM immunity to prevent
	  repeated killing of the same process, per-sandbox OOM priorities,
	  and full decision logging.

	  If unsure, say N.

config SENTRAOS_SIGNAL_RUST
	bool "SentraOS Signal Manager — race-free, thread-aware signals"
	depends on SENTRAOS_RUSTCORE
	help
	  Replaces the legacy kernel/signal.c delivery path (~4900 lines)
	  with a clean design:
	    - Lockless pending queues (atomic bitmask per thread)
	    - Thread-aware delivery (target specific thread or whole group)
	    - Async-safe exit handling (no use-after-free races)
	    - No raw sigset_t manipulation — safe atomic operations
	    - Per-sandbox signal accounting

	  Key entry points (do_send_sig_info, force_sig_info_to_task,
	  dequeue_signal, flush_signals) redirect to the Rust manager
	  when this is enabled.  The legacy C code remains untouched.

	  If unsure, say N.
```

## kernel/drivers/dac/Kconfig
```kconfig
# SPDX-License-Identifier: GPL-2.0
#
# Driver API Centre (DAC) configuration

config DRIVER_API_CENTRE
	bool "Driver API Centre — sandbox and validate all drivers"
	depends on RUST
	select FW_HEALTH
	help
	  The Driver API Centre (DAC) provides:
	    - Per-driver sandboxing with fault isolation and recovery
	    - API key validation for every kernel call a driver makes
	    - Unified per-driver ring-buffer logging via sysfs
	    - Crash detection via fw_health heartbeat monitoring
	    - Transparent wrapping of all existing drivers (no source changes)

	  When a driver crashes, DAC prevents it from making further API
	  calls, logs the fault, and can trigger automatic recovery.

	  If unsure, say N.

config DAC_DEBUG
	bool "DAC debugging — log every API call"
	depends on DRIVER_API_CENTRE
	help
	  Logs every API call through the DAC gateway.  Very verbose.

config DAC_LEGACY_RTLWIFI
	bool "Rewrite Realtek rtlwifi in Rust with native DAC API"
	depends on DRIVER_API_CENTRE
	help
	  Replaces the legacy C rtlwifi driver (508K lines, highest
	  crash rate) with a Rust implementation using DAC for all
	  DMA/PCI/MMIO/log calls.
```

## kernel/sentraos/Kconfig
```kconfig
# SPDX-License-Identifier: GPL-2.0
#
# SentraOS Kernel Microkernel Transformation

config SENTRAOS
	bool "SentraOS Microkernel Architecture"
	depends on RUST
	help
	  Transforms Linux from a monolithic kernel to a microkernel-like
	  architecture with:
	    - Invisible monitoring daemon (stealth crash prevention)
	    - Primary + Backup orchestrator controllers
	    - Per-driver isolated address spaces (via sandbox page tables)
	    - IOMMU-enforced DMA isolation for all drivers
	    - User-space bridge for out-of-Ring-0 subsystem migration
	    - Lock ordering enforcement + deadlock prevention
	    - Race condition detection
	    - Automatic crash containment and recovery

	  This is the foundation for running drivers, filesystems, and
	  network stacks in isolated environments.

	  If unsure, say N.

config SENTRAOS_STEALTH
	bool "SentraOS: Invisible monitoring daemon"
	depends on SENTRAOS
	help
	  The monitor hides itself from /sys/module/, /proc/modules,
	  lsmod, kallsyms, and all kernel tracking.  It uses a hidden
	  memory pool and cannot be rmmod'd.

config SENTRAOS_ORCHESTRATOR
	bool "SentraOS: Primary + Backup orchestrator"
	depends on SENTRAOS
	help
	  Dual-controller orchestration with automatic failover.  The
	  backup shadows the primary's state transparently and takes
	  over within 100ms if the primary fails.

config SENTRAOS_ISOLATION
	bool "SentraOS: Driver isolation (sandbox page tables)"
	depends on SENTRAOS
	select IOMMU_API
	help
	  Each PCI driver runs in its own address space with
	  IOMMU-restricted DMA.  A driver crash is contained and
	  cannot bring down the kernel.

config SENTRAOS_CONCURRENCY
	bool "SentraOS: Lock ordering + race detection"
	depends on SENTRAOS
	help
	  Enforces lock ordering rules, detects potential deadlocks
	  before they happen, and tracks concurrent read/write access
	  to detect races.

config SENTRAOS_USER_BRIDGE
	bool "SentraOS: User-space subsystem bridge"
	depends on SENTRAOS
	help
	  Provides /dev/sentraos_bridge for communicating with
	  user-space daemons that handle filesystem, network, and
	  driver operations outside Ring 0.

config SENTRAOS_OBJECT_MANAGER
	bool "SentraOS: NT-style Object Manager"
	depends on SENTRAOS
	help
	  Windows NT-inspired unified object management subsystem.
	  All kernel entities (processes, threads, ports, endpoints,
	  events, files, devices) are managed as reference-counted
	  objects with:
	    - Hierarchical namespace (directory tree)
	    - Per-object security / access control
	    - Handle table with duplication and access checks
	    - Type descriptors with per-type operations

	  This is a required dependency for Mach IPC and Microkit
	  Channels.

config SENTRAOS_IPC
	bool "SentraOS: Mach-style port-based IPC"
	depends on SENTRAOS_OBJECT_MANAGER
	help
	  Mach microkernel-inspired port-based message passing:
	    - Port allocation / deallocation
	    - Message send / receive with timeouts
	    - Port rights (send, receive, send-once)
	    - Port sets for multiplexed receive
	    - Message queues with backpressure

	  Ports are first-class Object Manager objects.

config SENTRAOS_CHANNELS
	bool "SentraOS: seL4-style microkernel channels"
	depends on SENTRAOS_OBJECT_MANAGER
	help
	  seL4-inspired microkernel IPC primitives:
	    - Endpoints for synchronous IPC (call / wait / reply)
	    - Notifications for asynchronous event signaling
	    - Capability-based access control with grant / revoke
	    - Word-register message passing (fast, fixed-size)

	  Endpoints and notifications are first-class Object
	  Manager objects.

config SENTRAOS_OTA
	bool "SentraOS: OTA Update Manager"
	depends on SENTRAOS
	depends on SYSTEM_DATA_VERIFICATION
	depends on CRYPTO_SHA256
	help
	  Local OTA (over-the-air) update subsystem with staged
	  lifecycle and cryptographic verification:
	    - Stage → Apply → Rollback workflow
	    - SHA-256 payload integrity verification
	    - PKCS#7 signature verification against trusted keyring
	    - Multiple update types: hotpatch, module, kernel, config,
	      firmware
	    - No server connections — all operations are local

	  Updates are verified before staging.  The signature covers
	  the full update descriptor (header + metadata + payload).

	  If unsure, say N.

config SENTRAOS_OTA_STRICT_SIGN
	bool "SentraOS: Require all OTA updates to be signed"
	depends on SENTRAOS_OTA
	default y
	help
	  When set, every staged update must carry a valid PKCS#7
	  signature.  Unsigned update payloads are rejected.
	  This provides defence-in-depth against tampered payloads.

	  If unsure, say Y.
```

## usr/ai/Kconfig
```kconfig
# SPDX-License-Identifier: GPL-2.0
#
# AI subsystem configuration
#

menuconfig AI_SUBSYSTEM
	bool "AI Subsystem Support"
	depends on RUST
	help
	  Enable the AI subsystem — a kernel-level layer for managing,
	  monitoring, and accelerating AI workloads. Provides process
	  classification, memory optimisation, local model priority,
	  and a bridge to both local (ollama, opencode) and cloud AI
	  runtimes.

if AI_SUBSYSTEM

config AI_DEBUG
	bool "AI subsystem debug output"
	help
	  Enables verbose debug logging from the AI subsystem.

config AI_MEMORY_PRIORITY
	bool "AI memory priority allocation"
	default y
	help
	  When enabled, processes classified as AI workloads receive
	  memory allocation priority, transparent huge-page hints,
	  and reduced swap pressure.

config AI_LOCAL_PRIORITY
	bool "Prioritise local AI models"
	default y
	help
	  Prefer locally-running AI models over cloud endpoints.
	  The scheduler will adjust process nice values and CPU
	  time for AI-classified tasks.

config AI_CLOUD_ROUTING
	bool "Cloud AI routing support"
	default y
	help
	  Enable the cloud AI routing layer. Allows the AI manager
	  daemon to transparently route inference requests to
	  configured cloud endpoints.

config AI_MANAGER_DAEMON
	bool "AI manager daemon (userspace)"
	default y
	help
	  Build the userspace AI manager daemon (ai-mgr) which
	  communicates with the kernel module via ioctls and
	  manages model lifecycle, tool integration, and cloud
	  routing.

config AI_OLLAMA_INTEGRATION
	bool "Ollama integration"
	depends on AI_MANAGER_DAEMON
	default y
	help
	  Enable integration with locally-running Ollama instances.
	  The AI manager will detect, monitor, and optimise Ollama
	  inference processes.

config AI_OPENCODE_INTEGRATION
	bool "Opencode integration"
	depends on AI_MANAGER_DAEMON
	default y
	help
	  Enable integration with opencode processes. The AI
	  manager will detect and prioritise opencode AI tasks.

config AI_SYSFS
	bool "AI subsystem sysfs interface"
	default y
	help
	  Expose AI subsystem state and controls via sysfs at
	  /sys/kernel/ai/.

endif
```
